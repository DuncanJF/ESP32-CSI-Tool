## main/Kconfig.projbuild
```kconfig
menu "ESP32 CSI Tool Config"

    config WIFI_NATURE
        int "Nature of this device as a wifi network participant."
        default 0
        help
            Nature of this device as a wifi network participant.
            0 == Passive WiFi snooping
            1 == Actively send WiFi traffic on the configured channel
            2 == Access Point for the configured channel

    config DATA_EXPORT_FORMAT
        int "Data export format version"
        default 3
        help
            Select the serialization format of the CSI data records.
            0 == Collect but drop all data (used for performance testing)
            1 == Original CSV formatting version
            2 == JSON array formatting
            3 == Full record encoded as base64.               

    config ENABLE_SUMMARY_STATS
        bool "Collect statistics about CSI data rates."
        default 0
        help
            Collect statistics about CSI data rates and report to console.
            0 == Disable collection of statistics
            1 == Enable collection of statistics
            
    config ENABLE_STBC_HTLTF
        bool "Enable the collection of STBC CSI data."
        default 0
        help
            ESP32 WiFi supports Space-Time Block Code (STBC) but STBC needs multiple transmit antennae.
            Where it is known aprioro there will not be any STBC (eg. 1 Tx antenna of another ESP32) the data collection can be optimized to ignoring the STBC CSI data.

    config WIFI_CHANNEL
        int "WiFi Channel"
        default 6
        help
            Select the WiFi channel for the AP to communicate on. In North America, valid channels are {1,2,3,...,10,11}.

    config ESP_WIFI_SSID
        string "WiFi SSID"
        default "myssid"
        help
            SSID (network name) for the example to connect to.

    config ESP_WIFI_PASSWORD
        string "WiFi Password"
        default "mypassword"
        help
            WiFi password (WPA or WPA2) for the example to use.
    
    config PACKET_RATE
        int "Packet TX Rate"
        default "1000"
        help
            By transmitting at some number of packets per second, the ESP32 should receive CSI at the same rate.
            However, this is not guaranteed depending on overhead such as Serial baud rate.
            Minimum value: 1, Maximum value: 1000
endmenu
```

## passive/main/Kconfig.projbuild
```kconfig
menu "ESP32 CSI Tool Config"

    config DATA_EXPORT_FORMAT
        int "Data export format version"
        default 3
        help
            Select the serialization format of the CSI data records.
            0 == Collect but drop all data (used for performance testing)
            1 == Original CSV formatting version
            2 == JSON array formatting
            3 == Full record encoded as base64.               

    config ENABLE_SUMMARY_STATS
        bool "Collect statistics about CSI data rates."
        default 0
        help
            Collect statistics about CSI data rates and report to console.
            0 == Disable collection of statistics
            1 == Enable collection of statistics
            
    config ENABLE_STBC_HTLTF
        bool "Enable the collection of STBC CSI data."
        default 0
        help
            ESP32 WiFi supports Space-Time Block Code (STBC) but STBC needs multiple transmit antennae.
            Where it is known aprioro there will not be any STBC (eg. 1 Tx antenna of another ESP32) the data collection can be optimized to ignoring the STBC CSI data.
            
    config WIFI_CHANNEL
        int "WiFi Channel"
        default 6
        help
            Select the WiFi channel to listen to passively. In North America, valid channels are {1,2,3,...,10,11}.

        
endmenu
```
